## package/aic8800/Config.in
```kconfig
config BR2_PACKAGE_AIC8800
	bool "aic8800 (USB WiFi 6 + BT driver and firmware)"
	depends on BR2_LINUX_KERNEL
	help
	  Vendor driver + firmware for the Aicsemi AIC8800D80 USB WiFi/BT
	  module (Quectel FCU760K) on the Radxa Dragon Q6A, from Radxa's
	  DKMS packaging (github.com/radxa-pkg/aic8800, pinned commit).

	  Builds three out-of-tree kernel modules:
	    aic_load_fw    - USB probe + firmware download (re-enumerates)
	    aic8800_fdrv   - fullmac cfg80211 WiFi driver
	    aic_btusb      - BlueZ HCI driver for the BT interface

	  Kernel requirements (set in linux-dragon-q6a.fragment):
	  CONFIG_CFG80211, CONFIG_BT, USB host. CONFIG_BT_HCIBTUSB must
	  stay OFF or stock btusb grabs the BT interface first.

	  Firmware installs to /lib/firmware/aic8800_fw/USB/ (the path the
	  Radxa patch series bakes into the driver).

	  https://github.com/radxa-pkg/aic8800

comment "aic8800 needs a Linux kernel to be built"
	depends on !BR2_LINUX_KERNEL
```

## package/qairt-runtime/Config.in
```kconfig
config BR2_PACKAGE_QAIRT_RUNTIME
	bool "qairt-runtime"
	depends on BR2_aarch64
	help
	  Qualcomm AI Engine Direct (QAIRT/QNN) runtime libraries for the
	  HTP/Hexagon backend: libQnnHtp.so, libQnnHtpV68Stub.so,
	  libQnnHtpV68Skel.so, libQnnSystem.so, qnn-platform-validator, etc.

	  These come from the QAIRT SDK (aarch64-ubuntu-gcc variant), which
	  requires a Qualcomm account to download. Drop the extracted host
	  libs + V68 skels into blobs/qairt-runtime/ (see its README) before
	  enabling this. Off by default - the FastRPC acceptance test
	  (fastrpc_test -a v68) does not need it.

	  https://www.qualcomm.com/developer  (Qualcomm AI Engine Direct SDK)
```

## package/qcom-dsp-firmware/Config.in
```kconfig
config BR2_PACKAGE_QCOM_DSP_FIRMWARE
	bool "qcom-dsp-firmware"
	depends on BR2_aarch64
	help
	  Signed Qualcomm firmware for the Radxa Dragon Q6A, installed
	  under /lib/firmware/qcom at the paths the DTB's `firmware-name`
	  properties (and the drm/msm + venus drivers) point to:

	    remoteproc_cdsp: qcom/qcs6490/radxa/dragon-q6a/cdsp.mbn
	    remoteproc_adsp: qcom/qcs6490/radxa/dragon-q6a/adsp.mbn
	    gpu zap shader:  qcom/qcs6490/a660_zap.mbn
	    gpu sqe/gmu:     qcom/a660_sqe.fw, qcom/a660_gmu.bin
	    venus video:     qcom/vpu-2.0/venus.mbn
	    geni qup:        qcom/qcm6490/qupv3fw.elf

	  Vendored from upstream linux-firmware, where all of these are
	  marked "Licence: Redistributable" (see LICENSE.qcom/NOTICE.qcom).
	  The CDSP image version string MUST match the fastrpc shell from
	  qcom-dsp-shell (CDSP.HT.2.5.c4-00004-KODIAK-1); see
	  blobs/qcom-dsp-firmware/README.md.

	  If the blobs are absent the package installs nothing (the build
	  still succeeds, e.g. for the QEMU smoke test), but the CDSP will
	  NOT come up on real hardware until they are provided.
```

## package/qcom-dsp-shell/Config.in
```kconfig
config BR2_PACKAGE_QCOM_DSP_SHELL
	bool "qcom-dsp-shell"
	depends on BR2_aarch64
	help
	  Hexagon DSP-side shell + skels for the Radxa Dragon Q6A, from the
	  linux-msm/hexagon-dsp-binaries repo:

	    CDSP: CDSP.HT.2.5.c4-00004-KODIAK-1 (fastrpc_shell_unsigned_3 + skels)
	    ADSP: ADSP.HT.5.5.c9-00028-KODIAK-2 (fastrpc_shell_0 + skels)

	  Installed flat into /usr/lib/dsp, which is where the FastRPC
	  userspace looks (DSP_LIBRARY_PATH/ADSP_LIBRARY_PATH).

	  IMPORTANT: the CDSP shell version string MUST match the cdsp.mbn
	  installed by qcom-dsp-firmware, or FASTRPC_IOCTL_INIT_CREATE fails
	  with 0x80000600. See GOAL.md frozen tuple.

	  https://github.com/linux-msm/hexagon-dsp-binaries
```

## package/qcom-fastrpc/Config.in
```kconfig
config BR2_PACKAGE_QCOM_FASTRPC
	bool "qcom-fastrpc"
	depends on BR2_aarch64
	depends on BR2_TOOLCHAIN_HAS_THREADS
	select BR2_PACKAGE_LIBYAML
	select BR2_PACKAGE_LIBBSD
	help
	  Qualcomm FastRPC userspace (qualcomm/fastrpc, built from source):
	  libcdsprpc / libadsprpc shared libraries, the cdsprpcd /
	  adsprpcd default-listener daemons and the fastrpc_test harness
	  used by the acceptance test (fastrpc_test -a v68).

	  This is only the CPU-side RPC transport. The DSP-side shell and
	  skels come from qcom-dsp-shell, and the kernel-loaded DSP firmware
	  from qcom-dsp-firmware.

	  https://github.com/qualcomm/fastrpc
```
